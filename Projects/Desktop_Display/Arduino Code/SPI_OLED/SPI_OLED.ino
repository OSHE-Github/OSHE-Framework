#include <Arduino.h>
#include <U8g2lib.h>
#include <Adafruit_TinyUSB.h>
#include <math.h>

#ifdef U8X8_HAVE_HW_SPI
#include <SPI.h>
#endif

//Screen init
U8G2_SSD1309_128X64_NONAME0_F_4W_HW_SPI u8g2(U8G2_R0, 5, 7, 8);

//Var init
int rxData[4];
char *dataLabels[] = {"CPU:  ", "RAM:  ", "GPU:  ", "VRAM: "};
unsigned long lastDataTime = 0;
const short sleepTimeout = 2000;
bool showingSleepImage = true;

//Logo bitmap
const unsigned char logo[] PROGMEM = {0x18, 0x7E, 0x7E, 0xE7, 0xE7, 0x66, 0x24, 0x42};

//Animation variables
	unsigned char x = 0;
	unsigned char y = 0;
	char vx = 1;
	char vy = -2;

//Splash screen bitmap
const unsigned char sleepImage[] PROGMEM = {
	0x00, 0x00, 0x00, 0x00, 0x00, 0x00, 0x00, 0x00, 0x00, 0x00, 0x00, 0x00, 0x00, 0x00, 0x00, 0x00, 
	0x00, 0x00, 0x00, 0x00, 0x00, 0x00, 0x00, 0x00, 0x00, 0x00, 0x00, 0x00, 0x00, 0x00, 0x00, 0x00, 
	0x00, 0x00, 0x00, 0x00, 0x00, 0x00, 0x00, 0x00, 0x00, 0x00, 0x00, 0x00, 0x00, 0x00, 0x00, 0x00, 
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	0x00, 0x00, 0x00, 0x00, 0x00, 0x00, 0x00, 0x00, 0x00, 0x00, 0x00, 0x00, 0x00, 0x00, 0x00, 0x00
};

void setup() {
  //Setup USB device descriptors
  TinyUSBDevice.setProductDescriptor("OSHE Framework Desktop Display"); //Simplifies linux detection
  USBDevice.setID(5824, 6743); //Generic HID with a custom PID for detection

  //Initialize serial
  Serial.begin(115200);

  //Set proper SPI pins for Waveshare RP2350 Zero board.
  SPI.setTX(3);
  SPI.setSCK(6);
  SPI.setCS(5);

  //Start up the display
  u8g2.begin();
  u8g2.setFont(u8g2_font_6x10_tf);
  u8g2.setFontPosTop();
  u8g2.setFlipMode(1);
  drawWaiting();
}

//Idle function for when the board is waiting for data.
void drawWaiting() {
  u8g2.clearBuffer();
	u8g2.setBusClock(4000);
  u8g2.drawXBM(0, 0, 128, 64, sleepImage);
  u8g2.sendBuffer();
	u8g2.setBusClock(400000);
}

// Draw a horizontal percentage bar
void drawBar(int x, int y, int percent) {
  //Constant values defined for each bar
  const int maxWidth = 60;       
  const int height = 8;

  //Filtering for out of bounds values
  if (percent < 0) percent = 0;
  if (percent > 100) percent = 100;

  //Calculate how much of the bar should be filled
  int fillWidth = (percent * maxWidth) / 100;

  //Draw percentage bar outline and fill in accurate percentage
  u8g2.drawFrame(x, y, maxWidth, height);
	if (fillWidth > 2){
  	u8g2.drawBox(x + 1, y + 1, fillWidth - 2, height - 2);
	}
}

//Added args to increase modularity
void drawStats(char *labels[], int data[]) {
  //clear frame buffer
  u8g2.clearBuffer();

  // Display CPU utilization and percentage bar
  u8g2.setCursor(0, -0);
  u8g2.print(labels[0]);
  u8g2.print(data[0]);
  u8g2.print("%");
  drawBar(65, 0, data[0]);

  // Display physical RAM utilization and percentage bar
  u8g2.setCursor(0, 16);
  u8g2.print(labels[1]);
  u8g2.print(data[1]);
  u8g2.print("%");
  drawBar(65, 16, data[1]);

  // Display GPU utilization and percentage bar
  u8g2.setCursor(0, 32);
  u8g2.print(labels[2]);
  u8g2.print(data[2]);
  u8g2.print("%");
  drawBar(65, 32, data[2]);

  // Display VRAM utilization and percentage bar
  u8g2.setCursor(0, 48);
  u8g2.print(labels[3]);
  u8g2.print(data[3]);
  u8g2.print("%");
  drawBar(65, 48, data[3]);

  u8g2.sendBuffer();
}

//Bouncing OSHE logo animation
void bounceAnimation() {
  //Calculate next location
  x += vx;
  y += vy;

  //Bounce logic for 128x64 screen (Will rewrite to be scalable)
  if (x <= 0 || x >= 120) {
    vx = -vx;
    x += vx;
  }

  if (y <= 0 || y >= 56) {
    vy = -vy;
    y += vy;
  }

  //Draw and send frame buffer
  u8g2.drawXBM(x, y, 8, 8, logo);
  u8g2.sendBuffer();
}

//Draw image but don't draw any black pixels instead of overwriting white pixels
void drawTransparentImage(int x, int y, int sizeX, int sizeY, unsigned char image[]){
  char bitBuffer = 0;
  for(int i = 0; i < sizeX; i++){
      for(int j = 0; j < sizeY; j++){
        bitBuffer = image[i] << j;
        bitBuffer = bitBuffer >> 7;
        if(bitBuffer == 1){
          u8g2.drawPixel(x+i, y+j);
        }
      }
  }
}

//Scanning for data from the display
void loop() {
  if (Serial.available()) {
    String line = Serial.readStringUntil('\n');

    //Filter the input for the expected data values (Integers)
    if (sscanf(line.c_str(), "%d,%d,%d,%d", &rxData[0], &rxData[1], &rxData[2], &rxData[3]) == 4) {
      drawStats(dataLabels, rxData);
			lastDataTime = millis();
    }
  }

	if(millis()-lastDataTime > sleepTimeout){
		drawWaiting();
		delay(25);
	}
}
