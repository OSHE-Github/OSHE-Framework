#include <Arduino.h>
#include <U8g2lib.h>

#ifdef U8X8_HAVE_HW_SPI
#include <SPI.h>
#endif

U8G2_SSD1309_128X64_NONAME0_F_4W_HW_SPI u8g2(U8G2_R0, 5, 7, 8);

// ===== SENSOR VALUES =====
int cpu = 0, ram = 0, gpu = 0, vram = 0;

// ===== SLEEP SYSTEM =====
unsigned long lastDataTime = 0;
const unsigned long sleepTimeout = 10000;
bool showingSleepImage = true;


// ===== BITMAP =====
#define sleepImage_width 128
#define sleepImage_height 64

const unsigned char sleepImage[] PROGMEM = {
	0x00, 0x00, 0x00, 0x00, 0x00, 0x00, 0x00, 0x00, 0x00, 0x00, 0x00, 0x00, 0x00, 0x00, 0x00, 0x00, 
	0x00, 0x00, 0x00, 0x00, 0x00, 0x00, 0x00, 0x00, 0x00, 0x00, 0x00, 0x00, 0x00, 0x00, 0x00, 0x00, 
	0x00, 0x00, 0x00, 0x00, 0x00, 0x00, 0x00, 0x00, 0x00, 0x00, 0x00, 0x00, 0x00, 0x00, 0x00, 0x00, 
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	0x00, 0x00, 0x00, 0x00, 0x00, 0x00, 0x00, 0x00, 0x00, 0x00, 0x00, 0x00, 0x00, 0x00, 0x00, 0x00
};


// ===== DRAW SLEEP IMAGE =====
void drawSleepImage() {
  u8g2.clearBuffer();
  u8g2.drawXBMP(0, 0, 128, 64, sleepImage);
  u8g2.sendBuffer();
}


// ===== DRAW BAR =====
void drawBar(int x, int y, int percent) {

  const int maxWidth = 60;
  const int height = 8;

  percent = constrain(percent,0,100);
  int fillWidth = (percent * maxWidth) / 100;

  u8g2.drawFrame(x, y, maxWidth, height);

  if (fillWidth > 2)
    u8g2.drawBox(x + 1, y + 1, fillWidth - 2, height - 2);
}


// ===== DRAW STATS =====
void drawStats() {

  u8g2.clearBuffer();

  u8g2.setFont(u8g2_font_6x10_tf);
  u8g2.setFontPosTop();

  u8g2.setCursor(0,0);
  u8g2.print("CPU ");
  u8g2.print(cpu);
  u8g2.print("%");
  drawBar(55,0,cpu);

  u8g2.setCursor(0,16);
  u8g2.print("RAM ");
  u8g2.print(ram);
  u8g2.print("%");
  drawBar(55,16,ram);

  u8g2.setCursor(0,32);
  u8g2.print("GPU ");
  u8g2.print(gpu);
  u8g2.print("%");
  drawBar(55,32,gpu);

  u8g2.setCursor(0,48);
  u8g2.print("VRAM ");
  u8g2.print(vram);
  u8g2.print("%");
  drawBar(55,48,vram);

  u8g2.sendBuffer();
}


// ===== SETUP =====
void setup() {

  Serial.begin(115200);

  SPI.setTX(3);
  SPI.setSCK(6);
  SPI.begin();

  u8g2.begin();

  drawSleepImage();        // show image on boot
  lastDataTime = millis();
  showingSleepImage = true;
}


// ===== LOOP =====
void loop() {

  if (Serial.available()) {

    String line = Serial.readStringUntil('\n');

    if (sscanf(line.c_str(), "%d,%d,%d,%d", &cpu, &ram, &gpu, &vram) == 4) {

      lastDataTime = millis();

      if (showingSleepImage)
        showingSleepImage = false;

      drawStats();
    }
  }

  if (!showingSleepImage && millis() - lastDataTime > sleepTimeout) {

    drawSleepImage();
    showingSleepImage = true;
  }
}